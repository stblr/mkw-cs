SECTIONS {
    memcpy = 0x80005f34;
    outgoing_childCreate__Q23EGG5SceneFv = 0x80007f34;
    incoming_childDestroy__Q23EGG5SceneFv = 0x80007f38;
    reinit__Q23EGG5SceneFv = 0x80007f3c;
    draw__Q23EGG5SceneFv = 0x80007f48;
    main__Q26System6SystemFiPCPCc = 0x80008ef0;
    getSystemHeap__Q26System6SystemFv = 0x80008fac;
    initialize__Q26System6SystemFv = 0x80009194;
    run__Q26System6SystemFv = 0x8000951c;
    changeSceneWithCreator__Q26System12SceneManagerFlPQ23EGG12SceneCreator = 0x80009844;
    DVDOpen = 0x8015e2bc;
    DVDReadPrio = 0x8015e834;
    DVDClose = 0x8015e568;
    OSInit = 0x8019fc68;
    OSAllocFromMEM1ArenaLo = 0x801a1104;
    DCFlushRange = 0x801a162c;
    ICInvalidateRange = 0x801a1710;
    OSFatal = 0x801a4ec4;
    Relocate = 0x801a6d3c;
    OSCreateThread = 0x801a9e84;
    OSJoinThread = 0x801aa3ac;
    OSDetachThread = 0x801aa4ec;
    OSResumeThread = 0x801aa58c;
    __nw__FUl = 0x80229dcc;
    __nw__FUlPQ23EGG4Heapi = 0x80229de0;
    __dl__FPv = 0x80229e14;
    __ct__Q23EGG5SceneFv = 0x8023ad10;
    __dt__Q23EGG5SceneFv = 0x8023ad84;
    changeSiblingScene__Q23EGG12SceneManagerFl = 0x8023afe0;
    s_system__Q26System6System = 0x802a4080;
    s_instance__Q26System6System = 0x80385fc8;
    s_argc__Q26System6System = 0x80385fe8;
    s_argv__Q26System6System = 0x80385fec;
    s_sceneCreatorStatic__Q26System6System = 0x80385ff0;
    s_parentInstance__Q26System6System = 0x80386f60;

    dolStart = 0x80004000;
    dolEnd = 0x8038917c;

    relStart = 0x80399180;
    relEnd = 0x8076db50;
}
